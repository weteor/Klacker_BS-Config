## boards/arm/klacker_bs/Kconfig.board
```kconfig
# Klacker BS board configuration
# Copyright (c) 2022 weteor
# SPDX-License-Identifier: MIT

config BOARD_KLACKER_BS
        bool "klacker_bs"
        depends on SOC_NRF52840_QIAA
```

## boards/arm/klacker_bs/Kconfig.defconfig
```kconfig
# Copyright (c) 2022 weteor
# SPDX-License-Identifier: MIT

if BOARD_KLACKER_BS

config BOARD
        default "Klacker BS"

config ZMK_KEYBOARD_NAME
        default "Klacker BS"

if USB

config USB_NRFX
        default y

config USB_DEVICE_STACK
        default y

endif # USB

config BT_CTLR
        default BT

config ZMK_BLE
        default y

config ZMK_USB
        default y

config ZMK_BATTERY_VOLTAGE_DIVIDER
        default y

endif # BOARD_KLACKER_BS
```

## boards/arm/klacker_bs/klacker_bs_defconfig
```kconfig
# Copyright (c) 2022 weteor
# SPDX-License-Identifier: MIT

CONFIG_SOC_SERIES_NRF52X=y
CONFIG_SOC_NRF52840_QIAA=y
CONFIG_BOARD_KLACKER_BS=y

CONFIG_BUILD_OUTPUT_UF2=y

#enable MPU
CONFIG_ARM_MPU=y

#enable GPIO
CONFIG_GPIO=y

CONFIG_ZMK_SLEEP=y
CONFIG_ZMK_DISPLAY=n

CONFIG_USE_DT_CODE_PARTITION=y

CONFIG_MPU_ALLOW_FLASH_WRITE=y
CONFIG_NVS=y
CONFIG_SETTINGS_NVS=y
CONFIG_FLASH=y
CONFIG_FLASH_PAGE_LAYOUT=y
CONFIG_FLASH_MAP=y

CONFIG_LOG=n
CONFIG_ZMK_USB_LOGGING=n
# CONFIG_ZMK_LOG_LEVEL_DBG=y
#CONFIG_LOG_BUFFER_SIZE=65536
#CONFIG_LOG_STRDUP_BUF_COUNT=160
# CONFIG_SPI_LOG_LEVEL_DBG=y
# CONFIG_DISPLAY_LOG_LEVEL_DBG=y
# CONFIG_LVGL_LOG_LEVEL_DBG=y
# CONFIG_LVGL_USE_DEBUG=y
```

## config/west.yml
```yaml
manifest:
  remotes:
    - name: zmkfirmware
      url-base: https://github.com/weteor
  projects:
    - name: zmk
      remote: zmkfirmware
      revision: Tipper_TF_rev2
      import: app/west.yml
  self:
    path: config
```
